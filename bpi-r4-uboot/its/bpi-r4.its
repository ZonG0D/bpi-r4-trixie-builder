## bpi-r4-uboot/its/bpi-r4.its
```
/dts-v1/;

/ {
 description = "BPI-R4 FIT";
 #address-cells = <1>;

 images {
  kernel-1 {
   description = "Linux Kernel";
   data = /incbin/("__KERNEL__");
   type = "kernel";
   arch = "arm64";
   os = "linux";
   compression = "gzip";
   load = <0x44000000>;
   entry = <0x44000000>;
   hash-1 { algo = "sha1"; };
  };

  fdt-base {
   description = "BPI-R4 FDT";
   data = /incbin/("__FDT__");
   type = "flat_dt";
   arch = "arm64";
   compression = "none";
   load = <0x47000000>;
   hash-1 { algo = "sha1"; };
  };
 };

 configurations {
  conf-sd {
   description = "BPI-R4 SD boot";
   kernel = "kernel-1";
   fdt = "fdt-base";
  };
 };
};
```
